## src/sensors/bmi270plus/Kconfig
```kconfig
# BMI270_PLUS 6 Axis IMU configuration

# Copyright (c) 2021 Bosch Sensortec GmbH
# Copyright (c) 2022 Nordic Semiconductor ASA
# SPDX-License-Identifier: Apache-2.0

menuconfig BMI270_PLUS
	bool "BMI270 Inertial measurement unit"
	default y
	depends on DT_HAS_BOSCH_BMI270PLUS_ENABLED
	select I2C if $(dt_compat_on_bus,$(DT_COMPAT_BOSCH_BMI270PLUS),i2c)
	select SPI if $(dt_compat_on_bus,$(DT_COMPAT_BOSCH_BMI270PLUS),spi)
	help
	  Enable driver for BMI270_PLUS I2C-based imu sensor

if BMI270_PLUS

config BMI270_PLUS_BUS_I2C
	bool
	default y
	depends on $(dt_compat_on_bus,$(DT_COMPAT_BOSCH_BMI270PLUS),i2c)

config BMI270_PLUS_BUS_SPI
	bool
	default y
	depends on $(dt_compat_on_bus,$(DT_COMPAT_BOSCH_BMI270PLUS),spi)

choice BMI270_PLUS_TRIGGER_MODE
	prompt "Trigger mode"
	help
	  Specify the type of triggering to be used by the driver.

config BMI270_PLUS_TRIGGER_NONE
	bool "No trigger"

config BMI270_PLUS_TRIGGER_GLOBAL_THREAD
	bool "Use global thread"
	depends on GPIO
	select BMI270_PLUS_TRIGGER

config BMI270_PLUS_TRIGGER_OWN_THREAD
	bool "Use own thread"
	depends on GPIO
	select BMI270_PLUS_TRIGGER

endchoice

config BMI270_PLUS_TRIGGER
	bool

config BMI270_PLUS_THREAD_PRIORITY
	int "Thread priority"
	depends on BMI270_PLUS_TRIGGER_OWN_THREAD
	default 10
	help
	  Priority of thread used by the driver to handle interrupts.

config BMI270_PLUS_THREAD_STACK_SIZE
	int "Thread stack size"
	depends on BMI270_PLUS_TRIGGER_OWN_THREAD
	default 1024
	help
	  Stack size of thread used by the driver to handle interrupts.

endif # BMI270_PLUS
```
